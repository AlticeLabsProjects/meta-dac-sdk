## conf/layer.conf
```bitbake
# We have a conf and classes directory, add to BBPATH
BBPATH .= ":${LAYERDIR}"

# We have recipes-* directories, add to BBFILES
BBFILES:append = " ${LAYERDIR}/recipes-*/*/*.bb"
BBFILES:append = " ${LAYERDIR}/recipes-*/*/*.bbappend"

BBFILE_COLLECTIONS += "meta-dac"
BBFILE_PATTERN_meta-dac = "^${LAYERDIR}/"
BBFILE_PRIORITY_meta-dac = "6"

LAYERDEPENDS_meta-dac = "core"
LAYERSERIES_COMPAT_meta-dac = "kirkstone nanbield"

BB_GIT_SHALLOW ?= "1"
BB_GIT_SHALLOW_DEPTH ?= "1"
BB_GENERATE_SHALLOW_TARBALLS ?= "1"

OCI_IMAGE_BACKEND = "sloci-image"
```
